/*===================================================================
  This is a library for our I2C LED Backpacks

  Designed specifically to work with the 0.54" 14-segment LED HT16K33
  Backpack found on Aliexpress (Red PCB) 

  These displays use I2C to communicate, 2 pins are required to 
  interface. VI2C pins tied to 3V or 5V depending on you choice.
  There are multiple selectable I2C addresses.
  2 Address Select pins: 0x70, 0x71, 0x72 or 0x73
  3 Address Select pins: 0x70, 0x71, 0x72, 0x73, 0x74, 0x75, 0x76 or 0x77

  Written by David C. Boyce -Feb 28 2023.
  YouTube: @PCBoardRepair
  email: pcboardrepair@gmail.com   
*/

#include <Wire.h>
#include <Adafruit_GFX.h>
#include "Adafruit_LEDBackpack.h"

#ifndef _BitValue
  #define _BitValue(bit) (1<<(bit))
#endif

Adafruit_LEDBackpack matrix = Adafruit_LEDBackpack();

uint8_t count = 0;

const unsigned char seg14[] = {
  0x00, 0x00, //Space
  0x40, 0x06, //!
  0x02, 0x20, //"
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  0x00, 0x01, //~
};

#define DIGIT_14SEG 4
unsigned long int disp_buff[DIGIT_14SEG];

void str_display(char *str) {
  int i;
  char ch;
  for (i=0; i<DIGIT_14SEG; i++) {
    ch = (str[DIGIT_14SEG-i-1]-' ');
    matrix.displaybuffer[DIGIT_14SEG-i-1] = ((int)seg14[ch*2]<<8) + seg14[ch*2+1];
  }
}

void setup() {
  Serial.begin(115200);
  Serial.println();
  Serial.println("HT16K33 test");
  
  matrix.begin(0x70);  // pass in the address

  str_display("TEST"); delay(500);
  matrix.writeDisplay();

  delay(5000);

}

void loop() {
  while(count <= 16){
    //Paint one LED per row.
    //The HT16K33 internal memory looks like 8x16 bit matrix (8 rows, 16 columns)
    for (uint8_t i=0; i<4; i++) {
      matrix.displaybuffer[i] = _BitValue(count) ;
    }
    //Write the changes to the display
    matrix.writeDisplay();
    delay(250);
    if (count >= 15) {count = 0; break; } else { count++; }
  }

  for (uint8_t c=0; c<95; c++){
    for (uint8_t i=0; i<4; i++) {
        matrix.displaybuffer[DIGIT_14SEG-i-1] = ((int)seg14[c*2]<<8) + seg14[c*2+1];
    }
    //Write the changes to the display
    matrix.writeDisplay();
    delay(500);
  }

}
